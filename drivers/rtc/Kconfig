## drivers/rtc/Kconfig
```kconfig
# Copyright (c) 2022 Bjarki Arge Andreasen
# SPDX-License-Identifier: Apache-2.0

menuconfig RTC
	bool "Real-Time Clock (RTC) drivers"
	help
	  Enable RTC driver configuration.

if RTC

module = RTC
module-str = rtc
source "subsys/logging/Kconfig.template.log_config"

config RTC_INIT_PRIORITY
	int "RTC init priority"
	default KERNEL_INIT_PRIORITY_DEVICE
	help
	  RTC device driver initialization priority.

source "drivers/rtc/Kconfig.stm32"

endif # RTC
```

## drivers/rtc/Kconfig.stm32
```kconfig
# Copyright 2023 Prevas A/S
# SPDX-License-Identifier: Apache-2.0

config RTC_STM32
	bool "STM32 RTC driver"
	default y if !COUNTER
	depends on !SOC_SERIES_STM32F1X
	select USE_STM32_LL_RTC
	select USE_STM32_LL_PWR
	select USE_STM32_LL_RCC
	help
	  Build RTC driver for STM32 SoCs, excluding STM32F1 series.

choice RTC_STM32_CLOCK_SRC
	bool "RTC clock source"
	depends on RTC_STM32

config RTC_STM32_CLOCK_LSI
	bool "LSI"
	help
	  Use LSI as RTC clock

config RTC_STM32_CLOCK_LSE
	bool "LSE"
	help
	  Use LSE as RTC clock

endchoice #RTC_STM32_CLOCK_SRC
```

## drivers/sensor/dps368/Kconfig
```kconfig
# DPS368 temperature and pressure sensor configuration options

# Copyright (c) 2019 Infineon Technologies AG
# SPDX-License-Identifier: Apache-2.0

menuconfig DPS368
	bool "DPS368 sensor"
	depends on I2C
	help
	  Enable driver for DPS368 I2C-based temperature and pressure sensor.

if DPS368

menu "Attributes"

choice
	prompt "DPS368 temperature oversampling"
	default DPS368_TEMP_OSR_8X
	help
	  Select temperature oversampling for the DPS368 sensor.  Higher values
	  lead to more accurate readings, but higher power consumption.
config DPS368_TEMP_OSR_1X
	bool "x1"
config DPS368_TEMP_OSR_2X
	bool "x2"
config DPS368_TEMP_OSR_4X
	bool "x4"
config DPS368_TEMP_OSR_8X
	bool "x8"
config DPS368_TEMP_OSR_16X
	bool "x16"
config DPS368_TEMP_OSR_32X
	bool "x32"
config DPS368_TEMP_OSR_64X
	bool "x64"
config DPS368_TEMP_OSR_128X
	bool "x128"
endchoice

choice
	prompt "DPS368 pressure oversampling"
	default DPS368_PRESS_OSR_8X
	help
	  Select pressure oversampling for the DPS368 sensor.  Higher values
	  lead to more accurate readings, but higher power consumption.
config DPS368_PRESS_OSR_1X
	bool "x1"
config DPS368_PRESS_OSR_2X
	bool "x2"
config DPS368_PRESS_OSR_4X
	bool "x4"
config DPS368_PRESS_OSR_8X
	bool "x8"
config DPS368_PRESS_OSR_16X
	bool "x16"
config DPS368_PRESS_OSR_32X
	bool "x32"
config DPS368_PRESS_OSR_64X
	bool "x64"
config DPS368_PRESS_OSR_128X
	bool "x128"
endchoice

endmenu

endif # DPS368
```

## drivers/sensor/ds18b20/Kconfig
```kconfig
# DS18B20 temperature and humidity sensor configuration options

# Copyright (c) 2021-2022 G-Technologies Sdn. Bhd.
# SPDX-License-Identifier: Apache-2.0

config DS18B20
	bool "DS18B20 Temperature Sensor"
	depends on GPIO	
	help
	  Enable driver for DS18B20 1-Wire temperature sensors.
```

## drivers/sensor/dypa01/Kconfig
```kconfig
# Copyright (c) 2021 G-Technologies Sdn. Bhd.
# SPDX-License-Identifier: Apache-2.0

config DYPA01
	bool "DYPA01 DISTANCE SENSOR"
	help
	  Enable driver for the DYPA01.

if DYPA01



endif
```

## drivers/sensor/gp2y10/Kconfig
```kconfig
# Copyright (c) 2021 G-Technologies Sdn. Bhd.
# SPDX-License-Identifier: Apache-2.0

config GP2Y10
	bool "GP2Y10 Dust PM10 SENSOR"
	help
	  Enable driver for the GP2Y10.

if GP2Y10
endif
```

## drivers/sensor/htu31d/Kconfig
```kconfig
config HTU31D
    bool "HTU31D Relative Humidity & Temperature Sensor"
    depends on I2C
    help
      Enable driver for HTU31D Relative Humidity & Temperature Sensor.
```

## drivers/sensor/pasco2/Kconfig
```kconfig
# Copyright (c) 2021 Leica Geosystems AG
# SPDX-License-Identifier: Apache-2.0

# config PASCO2
# 	bool "gas sensor for CO2 sensing"
# 	depends on I2C
# 	help
#         Enable driver for PASCO2 gas sensor.
# endif



menuconfig PASCO2
	bool "PasCO2 sensor"
	depends on I2C
	help
	  Enable driver for the PASCO2 CO2 gas sensor.

if PASCO2

config PASCO2_TRIGGER
	bool "Trigger"
	depends on GPIO

choice
	prompt "Measurement mode"
	default PASCO2_PERIODIC_MODE

config  PASCO2_SINGLE_SHOT_MODE
	bool "single shot"

config  PASCO2_PERIODIC_MODE
	bool "periodic data acquisition"
endchoice

endif
```

## dts/bindings/lora/ebyte,e78.yaml
```yaml
# Copyright (c) 2022 G-Technologies Sdn. Bhd.
# SPDX-License-Identifier: Apache-2.0

description: GSM PPP modem

compatible: "ebyte,e78"

include: uart-device.yaml


properties:
 label:
      required: true
```

## dts/bindings/sensor/aiman,dypa01.yaml
```yaml
# Copyright (c) 2021 G-Technologies Sdn. Bhd.
# SPDX-License-Identifier: Apache-2.0

description: Aiman DYPA01 ultrasonic water level sensor

compatible: "aiman,dypa01"

include: uart-device.yaml
```

## dts/bindings/sensor/gtech,uart.yaml
```yaml
# Copyright (c) 2021 G-Technologies Sdn. Bhd.
# SPDX-License-Identifier: Apache-2.0

description: Gtech uart

compatible: "gtech,uart"

include: uart-device.yaml
```

## dts/bindings/sensor/infineon,dps368.yaml
```yaml
#
# Copyright (c) 2023 G-Technologies Sdn. Bhd. - All Rights Reserved
#
# Unauthorized copying and distributing of this file, via any medium is
# strictly prohibited.
#
# If received in error, please contact G-Technologies Sdn. Bhd. at
# info@gtsb.com.my, quoting the name of the sender and the addressee, then
# delete it from your system.
#
# Proprietary and confidential
#

description: Infineon DPS368 temperature and pressure sensor

include: i2c-device.yaml

compatible: "infineon,dps368"
```

## dts/bindings/sensor/infineon,pasco2.yaml
```yaml
# Copyright (c) 2023 G-Technologies Sdn. Bhd.
# SPDX-License-Identifier: Apache-2.0

description: PAS CO2 sensor with 2-Wire Interface.

compatible: "infineon,pasco2"

include: i2c-device.yaml
properties:
    int-gpios:
      type: phandle-array
      required: false
      description: |
        ALERT pin.

        This pin signals active high when produced by the sensor.  The
        property value should ensure the flags properly describe the
        signal that is presented to the driver.

    int-pin:
      type: int
      required: false
      default: 1
      description: |
          Specify the default accelerometer full-scale range.
          An X value for the config represents a range of +/- X G. Valid values
          are:
          0:  +/- 2g
          1:  +/- 4g
          2:  +/- 8g

    sampling_rate:
      type: int
      required: false
      default: 60
      description: |
        Specify the default sampling rate min 60s.

    calibration_ref:
      type: int
      required: false
      default: 400
      description: |
        Specify the default calibration referrence 400ppm.

    pressure_ref:
      type: int
      required: false
      default: 900
      description: |
        Specify the default pressure referrenceThe valid range
        of operation is 750 hPa to 1150 hPa.
```

## dts/bindings/sensor/maxim,ds18b20.yaml
```yaml
# Copyright (c) 2021-2022 G-Technologies Sdn. Bhd.
# SPDX-License-Identifier: Apache-2.0

description: |
    Maxim DHT (Digital-output Humidity and Temperature Sensor)

    The Maxim DHT family of sensors provide temperature and humidity
    measurements through a bidirectional serial digital signal.

compatible: "maxim,ds18b20"

include: base.yaml

properties:
  dio-gpios:
    type: phandle-array
    required: true
    description: |
      Pin on which sensor communication will be performed.

      Control and data are encoded by the duration of active low
      signals.  A pull up may be appropriate.

    
```

## dts/bindings/sensor/sharp,gp2y10.yaml
```yaml
# Copyright (c) 2021 G-Technologies Sdn. Bhd.
# SPDX-License-Identifier: Apache-2.0

description: Dust sensor

compatible: "sharp,gp2y10"

include: uart-device.yaml
```

## dts/bindings/sensor/te,htu31d.yaml
```yaml
# Copyright (c) 2023, Bard
# SPDX-License-Identifier: Apache-2.0

description: Te Humidity HTU31D humidity and temperature sensor

compatible: "te,htu31d"

include: i2c-device.yaml
```
