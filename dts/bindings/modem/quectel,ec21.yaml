## dts/bindings/modem/quectel,ec21.yaml
```yaml
# Copyright (c) 2020 Analog Life LLC
# SPDX-License-Identifier: Apache-2.0

description: quectel Ec21 modem

compatible: "quectel,ec21"

include: uart-device.yaml

properties:
  mdm-power-gpios:
    type: phandle-array
    required: true

  mdm-reset-gpios:
    type: phandle-array

  mdm-dtr-gpios:
    type: phandle-array

  mdm-wdisable-gpios:
    type: phandle-array
```
