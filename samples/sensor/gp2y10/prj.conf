## CMakeLists.txt
```
# SPDX-License-Identifier: Apache-2.0

cmake_minimum_required(VERSION 3.20.0)
include($ENV{ZEPHYR_BASE}/cmake/app/boilerplate.cmake NO_POLICY_SCOPE)
project(gp2y10)

FILE(GLOB app_sources src/*.c)
target_sources(app PRIVATE ${app_sources})
```

## prj.conf
```kconfig
CONFIG_STDOUT_CONSOLE=y
CONFIG_SERIAL=y
CONFIG_UART_INTERRUPT_DRIVEN=y
CONFIG_SENSOR=y
CONFIG_GP2Y10=y
CONFIG_LOG=y
CONFIG_SHELL=y
```

## src/main.c
```c
#include <zephyr/sys/printk.h>
#include <zephyr/drivers/sensor.h>


void main(void)
{
	const struct device *dev;
	struct sensor_value val;

	dev = device_get_binding("GP2Y10");

	if (!device_is_ready(dev)) {
		printk("sensor: device not found.\n");
		return;
	}

	while (1) {

		if (sensor_sample_fetch(dev) != 0) {
			printk("sensor: sample fetch fail.\n");
		}

		if (sensor_channel_get(dev, SENSOR_CHAN_PM_10, &val) != 0) {
			printk("sensor: channel get fail.\n");
		}

		printk("sensor: dust reading: %.2f ug/m3\n", sensor_value_to_double(&val));

		k_msleep(5000);
	}

}
```
